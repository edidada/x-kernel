## net/Kconfig
```kconfig
menu "Networking"

config KFEAT_NET
    bool "Enable networking support"
    help
      Enable the kernel networking stack and NIC driver integration.

config KFEAT_VSOCK
    bool "Enable virtio-vsock support"
    depends on KFEAT_NET
    help
      Enable AF_VSOCK support for guest and host communication.

config KFEAT_NET_FIXED_POLL_BUDGET
    bool "Use fixed network poller budgets"
    depends on KFEAT_NET
    default n
    help
      Disable adaptive RX/TX/Timer poll budgets and use the compile-time
      fixed background budget for every owned poller round.

endmenu
```

## tee/tipc/Kconfig
```kconfig
menu "Trusty IPC"

config KFEAT_TIPC
    bool "Enable Trusty IPC support"
    help
      Enable the transport-independent Trusty IPC core, process-local handle
      tables, and the Trusty-compatible syscall ABI.

config KFEAT_VSOCK_TIPC_BRIDGE
    bool "Enable Trusty-compatible vsock-TIPC bridge"
    depends on KFEAT_TIPC && KFEAT_VSOCK && KFEAT_TEE && ARCH_AARCH64
    help
      Enable the kernel bridge that maps selected host vsock ports to Trusty
      IPC services and exposes the Trusty vsock forwarder service to TAs.

config KFEAT_DYNAMIC_APPLOADER
    bool "Enable dynamic TA apploader"
    depends on KFEAT_VSOCK_TIPC_BRIDGE
    help
      Publish com.android.trusty.apploader.secure and allow the preinstalled
      apploader TA to launch in-memory TA images through the vsock-TIPC
      bridge. The acceptance apploader does not implement signature policy.

endmenu
```
